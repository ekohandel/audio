## fw/app/boards/arm/olimex_stm32_p407/Kconfig.board
```kconfig
# OLIMEX-STM32-P407 board configuration

# Copyright (c) 2020, Abe Kohandel <abe@electronshepherds.com>
# SPDX-License-Identifier: Apache-2.0

config BOARD_OLIMEX_STM32_P407
	bool "OLIMEX-STM32-P407 Development Board"
	depends on SOC_STM32F407XG
```

## fw/app/boards/arm/olimex_stm32_p407/Kconfig.defconfig
```kconfig
# OLIMEX-STM32-P407 board configuration

# Copyright (c) 2020, Abe Kohandel <abe@electronshepherds.com>
# SPDX-License-Identifier: Apache-2.0

if BOARD_OLIMEX_STM32_P407

config BOARD
	default "olimex_stm32_p407"

config UART_3
	default y
	depends on UART_CONSOLE

if I2S

config I2S_3
	default y
	depends on I2S

config I2S_STM32
	default y
	depends on I2S

endif # I2S

endif # BOARD_OLIMEX_STM32_P407
```
